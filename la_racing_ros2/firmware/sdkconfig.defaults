## la_racing_ros2/firmware/sdkconfig.defaults
```kconfig
CONFIG_HTTPD_MAX_REQ_HDR_LEN=1024

CONFIG_ESP_MAIN_TASK_STACK_SIZE=3000
CONFIG_ESP_TASK_WDT=n

CONFIG_SERVO_CENTER_PULSEWIDTH_US=1500
CONFIG_SERVO_MAX_DEFLECTION_PULSEWIDTH_US=200
CONFIG_SERVO_REVERSE=n
```

## la_racing_ros2/firmware/src/main/Kconfig.projbuild
```kconfig
menu "la_racing firmware settings"

    config MICRO_ROS_APP_STACK
        int "Stack the micro-ROS app (Bytes)"
        default 16000
        help
        Stack size in Bytes of the micro-ROS app

    config MICRO_ROS_APP_TASK_PRIO
        int "Priority of the micro-ROS app"
        default 5
        help
        Priority of micro-ros task higher value means higher priority

    config SERVO_CENTER_PULSEWIDTH_US
        int "Servo center pulsewidth in us"
        default 1500

    config SERVO_MAX_DEFLECTION_PULSEWIDTH_US
        int "Servo max deflection pulsewidth in us"
        default 200

    config SERVO_REVERSE
        bool "Reverse servo"
        default n
        
endmenu
```
